## configs/gcc-aarch64-linux-gnu.win-x64_defconfig
```kconfig
CONFIG_RECIPE:=rpi3-toolchain
DOCKER_IMAGE:=dockcross/windows-static-x64
TC_HOST:=x86_64-w64-mingw32.static
```

## configs/rpi4_defconfig
```kconfig
CONFIG_RECIPE:=rpi
CONFIG_VARIANT:=rpi4

CONFIG_USE_RPI_BOOTLOADER:=y

DOCKER_IMAGE:=vitalelement/rootbuilder
```

## configs/sway_release_defconfig
```kconfig
CONFIG_RECIPE:=sway

GIT_L_scdoc_scdoc:=4af1e1e
GIT_L_libdrm_libdrm:=libdrm-2.4.112
GIT_L_wayland_wayland:=1.21.0
GIT_L_wayland-protocols_wayland-protocols:=1.26
GIT_L_vulkan_vulkan-headers:=v1.3.220
GIT_L_vulkan_vulkan-loader:=v1.3.220
GIT_L_vulkan_glslang:=11.10.0
GIT_L_mesa_mesa:=mesa-22.1.3
GIT_L_xorgproto_xorgproto:=xorgproto-2022.1
GIT_L_libxcvt_libxcvt:=libxcvt-0.1.1
GIT_L_libepoxy_libepoxy:=1.5.9
GIT_L_libevdev_libevdev:=libevdev-1.12.1
GIT_L_libinput_libinput:=1.21.0
GIT_L_pixman_pixman:=285b9a9
GIT_L_xwayland_xwayland:=xwayland-22.1.3
GIT_L_libxkbcommon_libxkbcommon:=xkbcommon-1.4.1
GIT_L_libseat_libseat:=0.7.0
GIT_L_wlroots_wlroots:=0.15.1
GIT_L_json-c_json-c-headers:=d28ac67
GIT_L_sway_sway:=1.7
GIT_L_libva_libva:=2.14.0
GIT_L_ffmpeg_ffmpeg:=846488cca8
GIT_L_swaylock-effects_swaylock-effects:=v1.6-3
GIT_L_swayidle_swayidle:=36a474a
GIT_L_swaybg_swaybg:=c960898
GIT_L_kanshi_kanshi:=0faad75
GIT_L_mako_mako:=v1.7.1
GIT_L_grim_grim:=47e2658
GIT_L_slurp_slurp:=f4e7559
GIT_L_wl-clipboard_wl-clipboard:=v2.1.0-1-g89cd9f9
GIT_L_swappy_swappy:=0355760
GIT_L_pipewire_pipewire:=0.3.48
GIT_L_libfuse_libfuse:=7657ec1
GIT_L_gtk-layer-shell_gtk-layer-shell:=5a3a828
GIT_L_libportal_libportal:=a715724
GIT_L_xdg-desktop-portal_xdg-desktop-portal:=0b6909f
GIT_L_libinih_libinih:=r53
GIT_L_xdg-desktop-portal-wlr_portal-wlr:=1cc5ff5
GIT_L_waybar_waybar:=0.9.13
GIT_L_wshowkeys_wshowkeys:=e8bfc78
GIT_L_wf-recorder_wf-recorder:=v0.3.0-1-gbf161b4
GIT_L_mupdf_mupdf:=1.19.0
GIT_L_zathura_zathura:=0.4.9
GIT_L_zathura_zathura-plugin-mupdf:=0.3.8
GIT_L_zathura_zathura-plugin-poppler:=0.3.0
GIT_L_wlsunset_wlsunset:=cee422b
GIT_L_imv_imv:=4448fb6
GIT_L_light_light:=c5fb454
GIT_L_cxxopts_cxxopts:=v3.0.0
GIT_L_pamixer_pamixer:=1.6-1-gc9abe89
GIT_L_avizo_avizo:=1.2
```

## layers/bootloader/bootimage/bootimage/bootimage.its
```
/dts-v1/;
/{
        description = "VE-ROOT Boot Image";
        #address-cells = <1>;
        images {
                linux_kernel@1 {
                        description = "Kernel";
                        data = /incbin/("Image");
                        type = "kernel";
                        arch = "arm64";
                        os = "linux";
                        compression = "none";
                        load =  < {{ config['bootimage'].kernel_load }} >;
                        entry = < {{ config['bootimage'].kernel_entry }} >;
                        hash@1 {
                                algo = "sha256";
                        };
                };

                fdt@1 {
                        description = "FDT blob";
                        data = /incbin/("devicetree.dtb");
                        type = "flat_dt";
                        arch = "arm64";
                        load = <{{ config['bootimage'].dtb_load }}>;
                        compression = "none";
                        hash@1 {
                                algo = "sha256";
                        };
                };

                initramfs@1 {
                        description = "Initial RAM Disk.";
                        data = /incbin/("initramfs.cpio.gz");
                        type = "ramdisk";
                        arch = "arm64";
                        os = "linux";
                        load = <{{ config['bootimage'].initrd_load }}>;
                        compression = "none";
                        hash@1 {
                                algo = "sha256";
                        };
                };
{% if 'overlays' in config['bootimage'] %}
{% for overlay in config['bootimage'].overlays %}

                overlay_{{ overlay.replace('.dtbo', '') }}@1 {
                        data = /incbin/("{{ overlay }}");
                        type = "flat_dt";
                        arch = "arm64";
                        load = <{{ hex(int(config['bootimage'].overlay_load, 16)|int + (4096 * loop.index0)) }}>;
                        compression = "none";
                        hash@1 {
                                algo = "sha256";
                        };
                };

{% endfor %}
{% endif %}


        };

        configurations {
                default = "config@1";
                config@1{
                        description = "VE-ROOT BootImage";
                        kernel = "linux_kernel@1";
{% if 'overlays' in config['bootimage'] %}
                        fdt = "fdt@1"{% for overlay in config['bootimage'].overlays %},"overlay_{{ overlay.replace('.dtbo', '') }}@1{% endfor %}";
{% else %}
                        fdt = "fdt@1";
{% endif %}
                        ramdisk = "initramfs@1";
                        signature@1{
                                algo = "sha256,rsa2048";
                                key-name-hint = "uboot_rsa_dev";
                                sign-images = "fdt", "kernel", "ramdisk";
                        };
                };
        };
};
```

## layers/bootloader/build-fit/bootloader-build-fit.its
```
/dts-v1/;
/{
        description = "VE-ROOT Boot Image";
        #address-cells = <1>;
        images {
                linux_kernel@1 {
                        description = "Kernel";
                        data = /incbin/("Image");
                        type = "kernel";
                        arch = "arm64";
                        os = "linux";
                        compression = "none";
                        load =  < 0x80008000 >;
                        entry = < 0x80008000 >;
                        hash@1 {
                                algo = "sha256";
                        };
                };
        };

        configurations {
                default = "config@1";
                config@1{
                        description = "VE-ROOT BootImage";
                        kernel = "linux_kernel@1";
                        signature@1{
                                algo = "sha256,rsa2048";
                                key-name-hint = "uboot_rsa_dev";
                                sign-images = "kernel";
                        };
                };
        };
};
```

## layers/bootloader/updateimage/updateimage/updateimage.its
```
/dts-v1/;
/{
        description = "VE-ROOT Boot Image";
        #address-cells = <1>;
        images {
                linux_kernel@1 {
                        description = "Kernel";
                        data = /incbin/("Image");
                        type = "kernel";
                        arch = "arm64";
                        os = "linux";
                        compression = "none";
                        load =  < {{ config['bootimage'].kernel_load }} >;
                        entry = < {{ config['bootimage'].kernel_entry }} >;
                        hash@1 {
                                algo = "sha256";
                        };
                };

                fdt@1 {
                        description = "FDT blob";
                        data = /incbin/("devicetree.dtb");
                        type = "flat_dt";
                        arch = "arm64";
                        load = <{{ config['bootimage'].dtb_load }}>;
                        compression = "none";
                        hash@1 {
                                algo = "sha256";
                        };
                };

                initramfs@1 {
                        description = "Initial RAM Disk.";
                        data = /incbin/("initramfs.cpio.gz");
                        type = "ramdisk";
                        arch = "arm64";
                        os = "linux";
                        load = <{{ config['bootimage'].initrd_load }}>;
                        compression = "none";
                        hash@1 {
                                algo = "sha256";
                        };
                };
        };

        configurations {
                default = "config@1";
                config@1{
                        description = "VE-ROOT BootImage";
                        kernel = "linux_kernel@1";
                        fdt = "fdt@1";
                        ramdisk = "initramfs@1";
                        signature@1{
                                algo = "sha256,rsa2048";
                                key-name-hint = "uboot_rsa_dev";
                                sign-images = "fdt", "kernel", "ramdisk";
                        };
                };
        };
};
```

## recipes/rpi3/bootimage.its
```
/dts-v1/;
/{
        description = "Configuration to load a Basic Kernel";
        #address-cells = <1>;
        images {
                linux_kernel@1 {
                        description = "Linux Image";
                        data = /incbin/("Image");
                        type = "kernel";
                        arch = "arm64";
                        os = "linux";
                        compression = "none";
                        load =  <0x00800000>;
                        entry = <0x00800000>;
                        hash@1 {
                                algo = "sha256";
                        };
                };

                fdt@1 {
                        description = "FDT blob";
                        data = /incbin/("devicetree.dtb");
                        type = "flat_dt";
                        arch = "arm64";
                        load = <0x02600000>;
                        compression = "none";
                        hash@1 {
                                algo = "sha256";
                        };
                };

                overlay@2 {
                        data = /incbin/("pi3-miniuart-bt.dtbo");
                        type = "flat_dt";
                        arch = "arm64";
                        load = <0x02800000>;
                        compression = "none";
                        hash@1 {
                                algo = "sha256";
                        };
                };

                overlay@3 {
                        data = /incbin/("pi3-disable-bt.dtbo");
                        type = "flat_dt";
                        arch = "arm64";
                        load = <0x02900000>;
                        compression = "none";
                        hash@1 {
                                algo = "sha256";
                        };
                };

                initramfs@1 {
                        description = "Initial RAM fs.";
                        data = /incbin/("initramfs.cpio.gz");
                        type = "ramdisk";
                        arch = "arm64";
                        os = "linux";
                        load = <0x03000000>;
                        compression = "none";
                        hash@1 {
                                algo = "sha256";
                        };
                };
        };

        configurations {
                default = "config@1";
                config@1{
                        description = "RPI3 Linux with UART overlay.";
                        kernel = "linux_kernel@1";
                        fdt = "fdt@1";
                        ramdisk = "initramfs@1";
                        signature@1{
                                algo = "sha256,rsa2048";
                                key-name-hint = "uboot_rsa_dev";
                                sign-images = "fdt", "kernel", "ramdisk";
                        };
                };
        };
};
```
